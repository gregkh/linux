## drivers/gpu/drm/renesas/rz-du/Kconfig
```kconfig
# SPDX-License-Identifier: GPL-2.0
config DRM_RZG2L_MIPI_DSI
	tristate "RZ/G2L MIPI DSI Encoder Support"
	depends on DRM && DRM_BRIDGE && OF
	depends on ARCH_RENESAS || COMPILE_TEST
	select DRM_MIPI_DSI
	help
	  Enable support for the RZ/G2L Display Unit embedded MIPI DSI encoders.
```
