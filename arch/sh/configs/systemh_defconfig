## arch/um/Kconfig.debug
```kconfig
menu "Kernel hacking"

source "lib/Kconfig.debug"

config FRAME_POINTER
	bool
	default y if DEBUG_INFO

config PT_PROXY
	bool "Enable ptrace proxy"
	depends on XTERM_CHAN && DEBUG_INFO
	help
	This option enables a debugging interface which allows gdb to debug
	the kernel without needing to actually attach to kernel threads.
	If you want to do kernel debugging, say Y here; otherwise say N.

config GPROF
	bool "Enable gprof support"
	depends on DEBUG_INFO
	help
        This allows profiling of a User-Mode Linux kernel with the gprof
        utility.

        See <http://user-mode-linux.sourceforge.net/gprof.html> for more
        details.

        If you're involved in UML kernel development and want to use gprof,
        say Y.  If you're unsure, say N.

config GCOV
	bool "Enable gcov support"
	depends on DEBUG_INFO
	help
        This option allows developers to retrieve coverage data from a UML
        session.

        See <http://user-mode-linux.sourceforge.net/gprof.html> for more
        details.

        If you're involved in UML kernel development and want to use gcov,
        say Y.  If you're unsure, say N.

endmenu
```

## arch/x86_64/kernel/cpufreq/Kconfig
```kconfig
#
# CPU Frequency scaling
#

menu "CPU Frequency scaling"

source "drivers/cpufreq/Kconfig"

config CPU_FREQ_TABLE
       tristate "CPU frequency table helpers"
       depends on CPU_FREQ
       default y
       help
         Many CPUFreq drivers use these helpers, so only say N here if
	 the CPUFreq driver of your choice doesn't need these helpers.

	 If in doubt, say Y.

comment "CPUFreq processor drivers"
       depends on CPU_FREQ

config X86_POWERNOW_K8
	tristate "AMD Opteron/Athlon64 PowerNow!"
	depends on CPU_FREQ_TABLE
	help
	  This adds the CPUFreq driver for mobile AMD Opteron/Athlon64 processors.

	  For details, take a look at <file:Documentation/cpu-freq/>. 

	  If in doubt, say N.

config X86_POWERNOW_K8_ACPI
	bool
	depends on ((X86_POWERNOW_K8 = "m" && ACPI_PROCESSOR) || (X86_POWERNOW_K8 = "y" && ACPI_PROCESSOR = "y"))
	default y

config X86_SPEEDSTEP_CENTRINO
	tristate "Intel Enhanced SpeedStep"
	depends on CPU_FREQ_TABLE && ACPI_PROCESSOR
	help
	  This adds the CPUFreq driver for Enhanced SpeedStep enabled
	  mobile CPUs.  This means Intel Pentium M (Centrino) CPUs
	  or 64bit enabled Intel Xeons.

	  For details, take a look at <file:Documentation/cpu-freq/>.

	  If in doubt, say N.

config X86_SPEEDSTEP_CENTRINO_ACPI
	bool
	depends on X86_SPEEDSTEP_CENTRINO
	default y

config X86_ACPI_CPUFREQ
	tristate "ACPI Processor P-States driver"
	depends on CPU_FREQ_TABLE && ACPI_PROCESSOR
	help
	  This driver adds a CPUFreq driver which utilizes the ACPI
	  Processor Performance States.

	  For details, take a look at <file:Documentation/cpu-freq/>.

	  If in doubt, say N.

comment "shared options"
	depends on CPU_FREQ

config X86_ACPI_CPUFREQ_PROC_INTF
        bool "/proc/acpi/processor/../performance interface (deprecated)"
	depends on PROC_FS
	depends on X86_ACPI_CPUFREQ || X86_SPEEDSTEP_CENTRINO_ACPI || X86_POWERNOW_K8_ACPI
	help
	  This enables the deprecated /proc/acpi/processor/../performance
	  interface. While it is helpful for debugging, the generic,
	  cross-architecture cpufreq interfaces should be used.

	  If in doubt, say N.

config X86_P4_CLOCKMOD
	tristate "Intel Pentium 4 clock modulation"
	depends on CPU_FREQ_TABLE && EMBEDDED
	help
	  This adds the clock modulation driver for Intel Pentium 4 / XEON
	  processors.  When enabled it will lower CPU temperature by skipping
	  clocks.

	  This driver should be only used in exceptional
	  circumstances when very low power is needed because it causes severe
	  slowdowns and noticeable latencies.  Normally Speedstep should be used
	  instead.

	  For details, take a look at <file:Documentation/cpu-freq/>.

	  Unless you are absolutely sure say N.


config X86_SPEEDSTEP_LIB
        tristate
        depends on (X86_P4_CLOCKMOD)
        default (X86_P4_CLOCKMOD)


endmenu
```

## drivers/cpufreq/Kconfig
```kconfig
config CPU_FREQ
	bool "CPU Frequency scaling"
	help
	  CPU Frequency scaling allows you to change the clock speed of 
	  CPUs on the fly. This is a nice method to save power, because 
	  the lower the CPU clock speed, the less power the CPU consumes.

	  Note that this driver doesn't automatically change the CPU
	  clock speed, you need to either enable a dynamic cpufreq governor
	  (see below) after boot, or use a userspace tool.

	  For details, take a look at <file:Documentation/cpu-freq>.

	  If in doubt, say N.

config CPU_FREQ_DEBUG
	bool "Enable CPUfreq debugging"
	depends on CPU_FREQ
	help
	  Say Y here to enable CPUfreq subsystem (including drivers)
	  debugging. You will need to activate it via the kernel
	  command line by passing
	     cpufreq.debug=<value>

	  To get <value>, add 
	       1 to activate CPUfreq core debugging,
	       2 to activate CPUfreq drivers debugging, and
	       4 to activate CPUfreq governor debugging

config CPU_FREQ_STAT
       tristate "CPU frequency translation statistics"
       depends on CPU_FREQ && CPU_FREQ_TABLE
       default y
       help
         This driver exports CPU frequency statistics information through sysfs
         file system

config CPU_FREQ_STAT_DETAILS
       bool "CPU frequency translation statistics details"
       depends on CPU_FREQ && CPU_FREQ_STAT
       default n
       help
         This will show detail CPU frequency translation table in sysfs file
         system

choice
	prompt "Default CPUFreq governor"
	depends on CPU_FREQ
	default CPU_FREQ_DEFAULT_GOV_PERFORMANCE if !CPU_FREQ_SA1100 && !CPU_FREQ_SA1110
	default CPU_FREQ_DEFAULT_GOV_USERSPACE if CPU_FREQ_SA1100 || CPU_FREQ_SA1110
	help
	  This option sets which CPUFreq governor shall be loaded at
	  startup. If in doubt, select 'performance'.

config CPU_FREQ_DEFAULT_GOV_PERFORMANCE
	bool "performance"
	select CPU_FREQ_GOV_PERFORMANCE
	help
	  Use the CPUFreq governor 'performance' as default. This sets
	  the frequency statically to the highest frequency supported by
	  the CPU.

config CPU_FREQ_DEFAULT_GOV_USERSPACE
	bool "userspace"
	select CPU_FREQ_GOV_USERSPACE
	help
	  Use the CPUFreq governor 'userspace' as default. This allows
	  you to set the CPU frequency manually or when an userspace 
	  program shall be able to set the CPU dynamically without having
	  to enable the userspace governor manually.

endchoice

config CPU_FREQ_GOV_PERFORMANCE
       tristate "'performance' governor"
       depends on CPU_FREQ
       help
	  This cpufreq governor sets the frequency statically to the
	  highest available CPU frequency.

	  If in doubt, say Y.

config CPU_FREQ_GOV_POWERSAVE
       tristate "'powersave' governor"
       depends on CPU_FREQ
       help
	  This cpufreq governor sets the frequency statically to the
	  lowest available CPU frequency.

	  If in doubt, say Y.

config CPU_FREQ_GOV_USERSPACE
       tristate "'userspace' governor for userspace frequency scaling"
       depends on CPU_FREQ 
       help
	  Enable this cpufreq governor when you either want to set the
	  CPU frequency manually or when an userspace program shall
	  be able to set the CPU dynamically, like on LART 
	  <http://www.lart.tudelft.nl/>

	  For details, take a look at <file:Documentation/cpu-freq/>.

	  If in doubt, say Y.

config CPU_FREQ_GOV_ONDEMAND
	tristate "'ondemand' cpufreq policy governor"
	depends on CPU_FREQ
	help
	  'ondemand' - This driver adds a dynamic cpufreq policy governor.
	  The governor does a periodic polling and 
	  changes frequency based on the CPU utilization.
	  The support for this governor depends on CPU capability to
	  do fast frequency switching (i.e, very low latency frequency
	  transitions). 

	  For details, take a look at linux/Documentation/cpu-freq.

	  If in doubt, say N.
```

## drivers/input/keyboard/Kconfig
```kconfig
#
# Input core configuration
#
config INPUT_KEYBOARD
	bool "Keyboards" if EMBEDDED || !X86
	default y
	depends on INPUT
	help
	  Say Y here, and a list of supported keyboards will be displayed.
	  This option doesn't affect the kernel.

	  If unsure, say Y.

config KEYBOARD_ATKBD
	tristate "AT keyboard support" if !PC
	default y
	depends on INPUT && INPUT_KEYBOARD
	select SERIO
	select SERIO_LIBPS2
	select SERIO_I8042 if PC
	select SERIO_GSCPS2 if GSC
	help
	  Say Y here if you want to use a standard AT or PS/2 keyboard. Usually
	  you'll need this, unless you have a different type keyboard (USB, ADB
	  or other). This also works for AT and PS/2 keyboards connected over a
	  PS/2 to serial converter.

	  If unsure, say Y.

	  To compile this driver as a module, choose M here: the
	  module will be called atkbd.

config KEYBOARD_SUNKBD
	tristate "Sun Type 4 and Type 5 keyboard support"
	depends on INPUT && INPUT_KEYBOARD
	select SERIO
	help
	  Say Y here if you want to use a Sun Type 4 or Type 5 keyboard,
	  connected either to the Sun keyboard connector or to an serial
	  (RS-232) port via a simple adapter.

	  To compile this driver as a module, choose M here: the
	  module will be called sunkbd.

config KEYBOARD_LKKBD
	tristate "DECstation/VAXstation LK201/LK401 keyboard support"
	depends on INPUT && INPUT_KEYBOARD
	select SERIO
	help
	  Say Y here if you want to use a LK201 or LK401 style serial
	  keyboard. This keyboard is also useable on PCs if you attach
	  it with the inputattach program. The connector pinout is
	  described within lkkbd.c.

	  To compile this driver as a module, choose M here: the
	  module will be called lkkbd.

config KEYBOARD_XTKBD
	tristate "XT Keyboard support"
	depends on INPUT && INPUT_KEYBOARD
	select SERIO
	help
	  Say Y here if you want to use the old IBM PC/XT keyboard (or
	  compatible) on your system. This is only possible with a
	  parallel port keyboard adapter, you cannot connect it to the
	  keyboard port on a PC that runs Linux.

	  To compile this driver as a module, choose M here: the
	  module will be called xtkbd.

config KEYBOARD_NEWTON
	tristate "Newton keyboard"
	depends on INPUT && INPUT_KEYBOARD
	select SERIO
	help
	  Say Y here if you have a Newton keyboard on a serial port.

	  To compile this driver as a module, choose M here: the
	  module will be called newtonkbd.

config KEYBOARD_MAPLE
	tristate "Maple bus keyboard support"
	depends on SH_DREAMCAST && INPUT && INPUT_KEYBOARD && MAPLE
	help
	  Say Y here if you have a DreamCast console running Linux and have
	  a keyboard attached to its Maple bus.

	  To compile this driver as a module, choose M here: the
	  module will be called maple_keyb.

config KEYBOARD_AMIGA
	tristate "Amiga keyboard"
	depends on AMIGA && INPUT && INPUT_KEYBOARD
	help
	  Say Y here if you are running Linux on any AMIGA and have a keyboard
	  attached.

	  To compile this driver as a module, choose M here: the
	  module will be called amikbd.
```

## drivers/input/misc/Kconfig
```kconfig
#
# Input misc drivers configuration
#
config INPUT_MISC
	bool "Misc"
	depends on INPUT
	help
	  Say Y here, and a list of miscellaneous input drivers will be displayed.
	  Everything that didn't fit into the other categories is here. This option
	  doesn't affect the kernel.

	  If unsure, say Y.

config INPUT_PCSPKR
	tristate "PC Speaker support"
	depends on (ALPHA || X86 || X86_64 || MIPS || PPC_PREP || PPC_CHRP || PPC_PSERIES) && INPUT && INPUT_MISC
	help
	  Say Y here if you want the standard PC Speaker to be used for
	  bells and whistles.

	  If unsure, say Y.

	  To compile this driver as a module, choose M here: the
	  module will be called pcspkr.

config INPUT_SPARCSPKR
	tristate "SPARC Speaker support"
	depends on (SPARC32 || SPARC64) && INPUT && INPUT_MISC && PCI
	help
	  Say Y here if you want the standard Speaker on Sparc PCI systems
	  to be used for bells and whistles.

	  If unsure, say Y.

	  To compile this driver as a module, choose M here: the
	  module will be called sparcspkr.

config INPUT_M68K_BEEP
	tristate "M68k Beeper support"
	depends on M68K && INPUT && INPUT_MISC

config INPUT_UINPUT
	tristate "User level driver support"
	depends on INPUT && INPUT_MISC
	help
	  Say Y here if you want to support user level drivers for input
	  subsystem accessible under char device 10:223 - /dev/input/uinput.

	  To compile this driver as a module, choose M here: the
	  module will be called uinput.
```
